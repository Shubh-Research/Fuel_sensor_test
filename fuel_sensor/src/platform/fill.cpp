// Fill reports on the device (DESIGN.md §14). See fill.h.
#include "fill.h"

#include <Arduino.h>
#include <esp_heap_caps.h>
#include <freertos/semphr.h>
#include <cmath>
#include <cstring>
#include <new>
#include "../core/eventlog.h"
#include "../core/live.h"
#include "../core/version.h"
#include "app.h"
#include "events.h"
#include "logs.h"
#include "store.h"

// The fill-report signing key: generated by tools/build.py from keys/private/fill_report_signing.pem (gitignored, never
// committed). An image built without it (build.py --no-fill-key, or a plain IDE build) has the feature off.
#if __has_include("fill_key_gen.h")
#include "fill_key_gen.h"
#endif
#ifndef FS_FILL_KEY
#define FS_FILL_KEY 0
#endif

namespace fs {

namespace {

constexpr const char* kList = "fills.bin";
constexpr const char* kListTmp = "fills.tmp";
constexpr int kListKeep = 50;                  // after a compaction
constexpr int kListMax = 100;                  // compacted when it reaches this (6.3-12.6 KB of LittleFS)

SemaphoreHandle_t g_lock = nullptr;
StaticSemaphore_t g_lock_buf;
FillBook* g_book = nullptr;                    // heap (~1.6 KB), allocated once at setup
bool g_have_last = false;
uint8_t g_last[kFillCodeBytes];                // the newest report (the dashboard's "Last fill report" card)
bool g_unverified = false, g_tank = false;     // set by other tasks, taken by the loop task's tick

bool take(uint32_t ms = 3000) { return g_lock && xSemaphoreTake(g_lock, pdMS_TO_TICKS(ms)) == pdTRUE; }
void give() { xSemaphoreGive(g_lock); }
uint32_t now_s() { return uint32_t(app_now_ms() / 1000); }

int list_count() {
  const long n = fs_file_size(kList);
  return n > 0 ? int(n / long(kFillCodeBytes)) : 0;
}

bool list_get(int i, uint8_t code[kFillCodeBytes]) {
  const int n = list_count();
  if (i < 0 || i >= n) return false;
  return fs_file_read_at(kList, uint32_t(n - 1 - i) * kFillCodeBytes, code, kFillCodeBytes);
}

// Keeps the newest kListKeep records: written to fills.tmp, then renamed over the list (a cut leaves either file whole).
void list_compact() {
  const int n = list_count();
  if (n < kListMax) return;
  uint8_t* buf = static_cast<uint8_t*>(malloc(kListKeep * kFillCodeBytes));
  if (!buf) return;
  bool ok = fs_file_read_at(kList, uint32_t(n - kListKeep) * kFillCodeBytes, buf, kListKeep * kFillCodeBytes) &&
            fs_file_remove(kListTmp) && fs_file_append(kListTmp, buf, kListKeep * kFillCodeBytes);
  free(buf);
  if (ok && !fs_file_rename(kListTmp, kList)) ok = fs_file_remove(kList) && fs_file_rename(kListTmp, kList);
  if (!ok) FS_LOGE("fill", "report list compaction failed");
}

class DevStore final : public FillStore {
 public:
  bool save(const FillNv& nv) override { return store().save_fill(nv); }
  bool append(const uint8_t code[kFillCodeBytes]) override {
    std::memcpy(g_last, code, kFillCodeBytes);
    g_have_last = true;
    const bool ok = fs_file_append(kList, code, kFillCodeBytes);
    if (!ok) FS_LOGE("fill", "report list: append failed");
    list_compact();
    return ok;
  }
  void logged(const FillReport& r) override {
    FS_LOGI("fill", "report #%u (since reset %u): operator %ld cL, sensor %u cL, drained %u cL, flags 0x%x",
            unsigned(r.serial), unsigned(r.since_reset), r.operator_cl == kFillOperatorNone ? -1L : long(r.operator_cl),
            unsigned(r.sensor_cl), unsigned(r.drained_cl), unsigned(r.flags));
    log_event(Ev::FillReport, r.flags, r.serial);
  }
};
DevStore g_store;

void live_of(FillLive* f) {
  DeviceStatus s;
  app_status(&s);
  f->filled_um = s.fuel.filled_um;
  f->drained_um = s.fuel.drained_um;
  f->pending_um = s.fuel.pending_um;
  // No level yet (just after boot, before the first estimate or a remembered level): the status says source "none" with
  // level 0, or NaN. Never take that 0 as a level.
  f->has_level = s.out.source != Source::None && std::isfinite(s.out.level_mm);
  f->level_um = f->has_level ? int32_t(std::lround(s.out.level_mm * 1000.0)) : 0;
  // "Not confirmed" = the tracker is unsure of the level (Uncertain), has none (NoLevel / Fault), or the radar is lost. Holding
  // (splashing while fuel is poured: the last steady level is shown) is normal during a fill and does not flag it.
  f->confirmed = s.out.state != TrackState::Uncertain && s.out.state != TrackState::NoLevel && s.out.state != TrackState::Fault &&
                 s.radar_ok && !s.safe_mode;
  f->gen = s.fuel.gen;
  f->lpmm_ul = uint32_t(std::llround(s.tank.lpmm() * 1e6));
}

int http_of(FillResult r) {
  switch (r) {
    case FillResult::Ok: return 200;
    case FillResult::Off: return 503;
    case FillResult::Busy: case FillResult::NotOpen: case FillResult::NotReady: case FillResult::Measuring: return 409;
    case FillResult::BadInput: return 400;
    case FillResult::RateLimited: return 429;
    case FillResult::SignError: case FillResult::StoreError: return 500;
  }
  return 500;
}

const char* message_of(FillResult r) {
  switch (r) {
    case FillResult::Off: return "Fill reports are not available on this firmware.";
    case FillResult::Busy: return "A fill report is already open.";
    case FillResult::NotOpen: return "No fill report is open. Press Start filling first.";
    case FillResult::NotReady: return "Press End filling first.";
    case FillResult::Measuring: return "Still measuring. Wait until the level has settled.";
    case FillResult::BadInput: return "Check the value.";
    case FillResult::RateLimited: return "Too many fill reports. Wait 10 minutes.";
    case FillResult::SignError: return "The report could not be signed. Try again.";
    case FillResult::StoreError: return "Could not save to the device memory. Try again.";
    default: return "";
  }
}

// The open report's stage (no sensor litres before Confirm) and the last report. Lock held.
void write_state(JsonOut& j, uint32_t now) {
  const FillStage st = g_book->stage();
  const FillNv& nv = g_book->nv();
  j.boolean("enabled", g_book->enabled()).str("stage", fill_stage_text(st));
  if (st != FillStage::Idle) {
    j.uinteger("phone_start", nv.phone_start).uinteger("phone_end", nv.phone_end).integer("tz_min", nv.tz_min)
        .uinteger("since_start_s", g_book->since_start_s(now)).boolean("restarted", (nv.flags & kFillFlagRestart) != 0);
    if (st == FillStage::Measuring || st == FillStage::Ready) {
      j.uinteger("since_end_s", g_book->since_end_s(now)).uinteger("settle_min_s", FillBook::kSettleMinS)
          .uinteger("settle_max_s", FillBook::kSettleMaxS);
    }
  }
  if (g_have_last) fill_write_json(j, "last", g_last);
  else j.null("last");
}

}  // namespace

void fill_begin(const uint8_t mac[6]) {
  g_lock = xSemaphoreCreateMutexStatic(&g_lock_buf);
  g_book = new (std::nothrow) FillBook();
  if (!g_book) {
    FS_LOGE("fill", "no memory for fill reports");
    return;
  }
  if (fs_file_size(kList) < 0 && fs_file_size(kListTmp) > 0) fs_file_rename(kListTmp, kList);   // a cut compaction
  FillNv nv;
  const bool loaded = store().load_fill(&nv);
  g_have_last = list_get(0, g_last);
  FillReport last;
  if (g_have_last && fill_unpack(g_last, kFillCodeBytes, &last) && last.serial > nv.serial) {
    nv.serial = last.serial;                             // NVS lost (wiped by the core): the serial never goes back
    store().save_fill(nv);
  }
#if FS_FILL_KEY
  g_book->begin(&g_store, nv, kFillKeyD, kFillKeyId, mac, uint16_t(kFwVersionU16), now_s());
#else
  g_book->begin(&g_store, nv, nullptr, 0, mac, uint16_t(kFwVersionU16), now_s());
#endif
  FS_LOGI("fill", "fill reports %s; last serial %u, since reset %u, open: %s (record %s)", fill_enabled() ? "on" : "OFF (no key)",
          unsigned(nv.serial), unsigned(nv.since_reset), fill_stage_text(g_book->stage()), loaded ? "loaded" : "new");
}

bool fill_enabled() { return g_book && g_book->enabled(); }

void fill_note_tank_change() { g_tank = true; }
void fill_note_unverified() { g_unverified = true; }

void fill_tick(uint64_t now_ms) {
  if (!g_book) return;
  FillLive live;
  live_of(&live);
  const uint32_t now = uint32_t(now_ms / 1000);
  if (!take(200)) return;                                // (the HTTP task may be signing: the next second ticks)
  if (g_tank) { g_tank = false; g_book->note_tank_change(now); }
  if (g_unverified) { g_unverified = false; g_book->note_unverified(now); }
  if (g_book->enabled()) {
    bool closed = false;
    FillDone d;
    g_book->tick(now, live, store().settings_changes(), &d, &closed);
    if (closed) FS_LOGW("fill", "report #%u closed automatically", unsigned(d.r.serial));
  }
  give();
}

int fill_http_state(JsonOut& j) {
  j.begin_obj().boolean("ok", true);
  if (!g_book || !take()) {
    j.boolean("enabled", false).str("stage", "idle").null("last").end_obj();
    return 200;
  }
  write_state(j, now_s());
  give();
  j.end_obj();
  return 200;
}

namespace {
// The reply to an action; with the state when the caller holds the lock.
int reply(JsonOut& j, FillResult r, bool locked = true) {
  j.begin_obj().boolean("ok", r == FillResult::Ok);
  if (r != FillResult::Ok) j.str("error", fill_result_text(r)).str("message", message_of(r));
  if (g_book && locked) write_state(j, now_s());
  j.end_obj();
  return http_of(r);
}
}  // namespace

int fill_http_start(uint32_t phone_t, int tz_min, JsonOut& j) {
  if (!g_book) return reply(j, FillResult::Off, false);
  FillLive live;
  live_of(&live);
  if (!take()) return reply(j, FillResult::StoreError, false);
  const FillResult r = g_book->start(now_s(), phone_t, int16_t(tz_min < -840 || tz_min > 840 ? 9999 : tz_min), live,
                                     store().settings_changes());
  const int code = reply(j, r);
  give();
  return code;
}

int fill_http_end(uint32_t phone_t, JsonOut& j) {
  if (!g_book) return reply(j, FillResult::Off, false);
  if (!take()) return reply(j, FillResult::StoreError, false);
  const int code = reply(j, g_book->end(now_s(), phone_t));
  give();
  return code;
}

int fill_http_confirm(double litres, JsonOut& j) {
  if (!g_book) return reply(j, FillResult::Off, false);
  if (!std::isfinite(litres) || litres < 0 || litres > 100000) return reply(j, FillResult::BadInput, false);
  FillLive live;
  live_of(&live);
  if (!take()) return reply(j, FillResult::StoreError, false);
  FillDone d;
  const FillResult r = g_book->confirm(now_s(), uint32_t(std::llround(litres * 100.0)), live, store().settings_changes(), &d);
  int code;
  if (r == FillResult::Ok) {
    j.begin_obj().boolean("ok", true);
    fill_write_json(j, "report", d.code);
    write_state(j, now_s());
    j.end_obj();
    code = 200;
  } else {
    code = reply(j, r);
  }
  give();
  return code;
}

int fill_log_count() {
  if (!take()) return 0;
  const int n = list_count();
  give();
  return n;
}

bool fill_log_get(int i, uint8_t code[kFillCodeBytes]) {
  if (!take()) return false;
  const bool ok = list_get(i, code);
  give();
  return ok;
}

bool fill_reset_at_boot() {
  FillNv nv;
  store().load_fill(&nv);                                // (none stored: a zero record keeps serial 0)
  const FillNv z = fill_nv_after_reset(nv);
  const bool list = fs_file_remove(kList) && fs_file_remove(kListTmp);
  const bool rec = (nv.since_reset == 0 && nv.stage == 0) || store().save_fill(z);
  return list && rec;
}

}  // namespace fs
